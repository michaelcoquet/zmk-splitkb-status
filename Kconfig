## Kconfig
```kconfig
# zmk-splitkb-status/Kconfig
#
# ZMK-aware status indicators for the SplitKB keyboard. Each indicator is an
# independent option so a half only pulls in the code it needs.

menuconfig SPLITKB_TRACKBALL_BATTERY
    bool "Right-half battery indicator on the PIM447 trackball LED"
    depends on PIM447 && ZMK_BATTERY_REPORTING
    help
      Pulses the trackball RGBW LED orange when this half's own battery is
      low and red when critical. Off otherwise. Runs on the peripheral half
      using its local battery state, so no split forwarding is needed.

if SPLITKB_TRACKBALL_BATTERY

config SPLITKB_TRACKBALL_BATTERY_LOW
    int "Low battery threshold (percent)"
    default 20
    help
      At or below this state-of-charge the LED pulses orange.

config SPLITKB_TRACKBALL_BATTERY_CRIT
    int "Critical battery threshold (percent)"
    default 5
    help
      At or below this state-of-charge the LED pulses red (faster).

endif # SPLITKB_TRACKBALL_BATTERY

menuconfig SPLITKB_UNDERGLOW_STATUS
    bool "Status indicators on the underglow strip (central)"
    depends on ZMK_RGB_UNDERGLOW && ZMK_HID_INDICATORS && ZMK_BATTERY_REPORTING
    help
      On the central half, drives the underglow as a shared status surface,
      priority-ordered: critical battery (red pulse) > low battery (orange
      pulse) > caps lock (solid white) > nothing (restore default look).
      Pulsing stops on idle and re-asserts on wake.

      Note: ZMK exposes no getter for the current underglow color/effect, so
      the hand-back restores the ZMK_RGB_UNDERGLOW_*_START defaults rather
      than whatever was running before.

if SPLITKB_UNDERGLOW_STATUS

config SPLITKB_UNDERGLOW_BATTERY_LOW
    int "Low battery threshold (percent)"
    default 20

config SPLITKB_UNDERGLOW_BATTERY_CRIT
    int "Critical battery threshold (percent)"
    default 5

endif # SPLITKB_UNDERGLOW_STATUS

module = SPLITKB_STATUS
module-str = splitkb_status
source "subsys/logging/Kconfig.template.log_config"
```
